## trfs/Kconfig
```kconfig
config TR_FS
	tristate "Tracefs stackable file system (EXPERIMENTAL)"
	help
	  Trfs is a stackable file system which simply passes its
	  operations to the lower layer.  It is designed as a useful
	  template for developing or debugging other stackable file systems,
	  and more.
```
